## examples/zephyr/boards/noisesculptors/szrapnel/Kconfig.defconfig
```kconfig
#
# Copyright (c) 2025, Kresimir Popovic
#
# SPDX-License-Identifier: Apache-2.0
#

if BOARD_SZRAPNEL

config USB_CLOCK
    bool "Use PLL1Q for USB clock"
    default n

endif
```

## examples/zephyr/boards/noisesculptors/szrapnel/Kconfig.szrapnel
```kconfig
#
# Copyright (c) 2025, Kresimir Popovic
#
# SPDX-License-Identifier: Apache-2.0
#

config BOARD_SZRAPNEL
    select SOC_STM32H750XX
```

## examples/zephyr/boards/noisesculptors/szrapnel/board.yml
```yaml
board:
  name: szrapnel
  full_name: Szrapnel
  vendor: noisesculptors
  socs:
    - name: stm32h750xx
```

## examples/zephyr/boards/noisesculptors/szrapnel/szrapnel_defconfig
```kconfig
#
# Copyright (c) 2025, Kresimir Popovic
#
# SPDX-License-Identifier: Apache-2.0
#
CONFIG_CONSOLE=y
CONFIG_FLASH=y
CONFIG_SERIAL=y
CONFIG_GPIO=y
CONFIG_SYS_CLOCK_HW_CYCLES_PER_SEC=480000000
CONFIG_UART_CONSOLE=y

# CONFIG_ARM_MPU=y
# CONFIG_UART_INTERRUPT_DRIVEN=y
# CONFIG_XIP=y
```
